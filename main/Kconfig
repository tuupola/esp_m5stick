## main/Kconfig
```kconfig
menu "M5StickC configuration"

config WIFI_SSID
    string "WiFi SSID"
    default "hello"

config WIFI_PASSWORD
    string "WiFi password"
    default "s11kr3t"

endmenu
```
